## boards/shields/840dk/Kconfig.defconfig
```kconfig
if SHIELD_840DK

# Name must be less than 16 characters long!
config ZMK_KEYBOARD_NAME
    default "Dev Kit Board"

endif
```

## boards/shields/840dk/Kconfig.shield
```kconfig
# No whitespace after the comma or in your keyboard name!
config SHIELD_840DK
    def_bool $(shields_list_contains,840dk)
```

## boards/shields/imp/Kconfig.shield
```kconfig
# No whitespace after the comma or in your keyboard name!
config SHIELD_IMP
    def_bool $(shields_list_contains,imp)
```
